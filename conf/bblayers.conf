## conf/bblayers.conf
```bitbake
# POKY_BBLAYERS_CONF_VERSION is increased each time build/conf/bblayers.conf
# changes incompatibly
POKY_BBLAYERS_CONF_VERSION = "2"

BBPATH = "${TOPDIR}"
BBFILES ?= ""

BBLAYERS ?= " \
/home/lgomez/morty/meta \
/home/lgomez/morty/meta-poky \
/home/lgomez/morty/meta-yocto-bsp \
/home/lgomez/morty/meta-xilinx/meta-xilinx-bsp \
/home/lgomez/morty/meta-xilinx-tools \
/home/lgomez/morty/meta-gpio \
/home/lgomez/morty/meta-openembedded/meta-oe \ 
/home/lgomez/morty/meta-openembedded/meta-python \
/home/lgomez/morty/meta-rust-hello-world \
/home/lgomez/morty/meta-rust \
"
```

## meta-gpedals-bsp/conf/layer.conf
```bitbake
# We have a conf and classes directory, add to BBPATH
BBPATH .= ":${LAYERDIR}"

# We have recipes-* directories, add to BBFILES
BBFILES += "${LAYERDIR}/recipes-*/*/*.bb \
            ${LAYERDIR}/recipes-*/*/*.bbappend"

BBFILE_COLLECTIONS += "meta-gpedals-bsp"
BBFILE_PATTERN_meta-gpedals-bsp = "^${LAYERDIR}/"
BBFILE_PRIORITY_meta-gpedals-bsp = "6"
```

## meta-hello-cmake/conf/layer.conf
```bitbake
# We have a conf and classes directory, add to BBPATH
BBPATH .= ":${LAYERDIR}"

# We have recipes-* directories, add to BBFILES
BBFILES += "${LAYERDIR}/recipes-*/*/*.bb \
	${LAYERDIR}/recipes-*/*/*.bbappend"

BBFILE_COLLECTIONS += "meta-hello-cmake"
BBFILE_PATTERN_meta-hello-cmake = "^${LAYERDIR}/"
BBFILE_PRIORITY_meta-hello-cmake = "6"
```

## meta-rust-gpio/conf/layer.conf
```bitbake
# We have a conf and classes directory, add to BBPATH
BBPATH .= ":${LAYERDIR}"

# We have recipes-* directories, add to BBFILES
BBFILES += "${LAYERDIR}/recipes-*/*/*.bb \
            ${LAYERDIR}/recipes-*/*/*.bbappend"

BBFILE_COLLECTIONS += "meta-rust-gpio"
BBFILE_PATTERN_meta-rust-gpio = "^${LAYERDIR}/"
BBFILE_PRIORITY_meta-rust-gpio = "6"

LAYERDEPENDS_meta-rust-gpio = "core"
LAYERSERIES_COMPAT_meta-rust-gpio = "rocko"
```

## meta-rust-hello-world/conf/layer.conf
```bitbake
# We have a conf and classes directory, add to BBPATH
BBPATH .= ":${LAYERDIR}"

# We have recipes-* directories, add to BBFILES
BBFILES += "${LAYERDIR}/recipes-*/*/*.bb \
            ${LAYERDIR}/recipes-*/*/*.bbappend"

BBFILE_COLLECTIONS += "meta-rust-hello-world"
BBFILE_PATTERN_meta-rust-hello-world = "^${LAYERDIR}/"
BBFILE_PRIORITY_meta-rust-hello-world = "6"

LAYERDEPENDS_meta-rust-hello-world = "core"
LAYERSERIES_COMPAT_meta-rust-hello-world = "rocko"
```

## meta-wt-hello/conf/layer.conf
```bitbake
# We have a conf and classes directory, add to BBPATH
BBPATH .= ":${LAYERDIR}"

# We have recipes-* directories, add to BBFILES
BBFILES += "${LAYERDIR}/recipes-*/*/*.bb \
            ${LAYERDIR}/recipes-*/*/*.bbappend"

BBFILE_COLLECTIONS += "meta-wt-hello"
BBFILE_PATTERN_meta-wt-hello = "^${LAYERDIR}/"
BBFILE_PRIORITY_meta-wt-hello = "6"

LAYERDEPENDS_meta-wt-hello = "core"
LAYERSERIES_COMPAT_meta-wt-hello = "dunfell"
```
